// Generated by scripts/generate_web_page_assets.py. Do not edit.
// WebCommonScript.js: 2539 B -> 993 B.
#define WEB_SCRIPT_ASSET_VERSION "b74728e6ab9d"
const uint8_t WEB_SCRIPT_GZIP[] PROGMEM = {
    0x1f, 0x8b, 0x08, 0x00, 0x00, 0x00, 0x00, 0x00, 0x02, 0xff, 0x9d, 0x56, 0x5d, 0x8f, 0xea, 0x36,
    0x10, 0xfd, 0x2b, 0xdc, 0x17, 0x9c, 0x48, 0x89, 0xab, 0xdb, 0xbe, 0x41, 0xd3, 0x6a, 0x3f, 0xa8,
    0x5a, 0x69, 0xab, 0x7b, 0xb5, 0x6c, 0xa5, 0x5b, 0x55, 0x7d, 0x70, 0xe2, 0x09, 0x98, 0x75, 0x6c,
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    0x00,
};
#if ESP32BASE_ENABLE_APP_CONFIG
// WebAppConfigStyle.css: 3378 B -> 1099 B.
#define WEB_APPCFG_ASSET_VERSION "c46e1537194a"
const uint8_t WEB_APPCFG_GZIP[] PROGMEM = {
    0x1f, 0x8b, 0x08, 0x00, 0x00, 0x00, 0x00, 0x00, 0x02, 0xff, 0xad, 0x56, 0xeb, 0x6e, 0xab, 0x38,
    0x10, 0x7e, 0x15, 0xa4, 0xea, 0x48, 0x41, 0x0a, 0x11, 0xb7, 0xa4, 0x2d, 0x68, 0x57, 0xfb, 0x1a,
    0xab, 0xd5, 0xf9, 0x61, 0xf0, 0x38, 0x78, 0x97, 0xd8, 0xc8, 0x38, 0x97, 0x1e, 0xd4, 0x77, 0xdf,
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    0xfd, 0xfe, 0x3f, 0x25, 0xc0, 0x0a, 0x53, 0x32, 0x0d, 0x00, 0x00,
};
#endif
#if ESP32BASE_ENABLE_APP_CONFIG
// WebAppConfigScript.js: 2194 B -> 935 B.
#define WEB_APPCFG_SCRIPT_ASSET_VERSION "e2ca63383d1c"
const uint8_t WEB_APPCFG_SCRIPT_GZIP[] PROGMEM = {
    0x1f, 0x8b, 0x08, 0x00, 0x00, 0x00, 0x00, 0x00, 0x02, 0xff, 0x9d, 0x55, 0x4d, 0x6f, 0xdb, 0x38,
    0x10, 0xbd, 0xef, 0xaf, 0x90, 0xbd, 0x40, 0x28, 0xc1, 0xaa, 0x92, 0x45, 0x4f, 0x6b, 0x45, 0x0e,
    0xd2, 0xd6, 0x8b, 0xb6, 0xc8, 0xa6, 0xc0, 0xda, 0x58, 0xa0, 0x30, 0x7c, 0xa0, 0xa8, 0x91, 0x4c,
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    0x59, 0xa3, 0x63, 0x92, 0x08, 0x00, 0x00,
};
#endif
#if ESP32BASE_ENABLE_OTA
// WebOtaScript.js: 1816 B -> 814 B.
#define WEB_OTA_SCRIPT_ASSET_VERSION "9726499bd57b"
const uint8_t WEB_OTA_SCRIPT_GZIP[] PROGMEM = {
    0x1f, 0x8b, 0x08, 0x00, 0x00, 0x00, 0x00, 0x00, 0x02, 0xff, 0xad, 0x55, 0x4d, 0x8f, 0xdb, 0x36,
    0x10, 0xbd, 0xf7, 0x57, 0xa8, 0x87, 0x84, 0x52, 0xad, 0xd0, 0xda, 0x2d, 0x5a, 0x14, 0x11, 0x98,
    0xa2, 0x4d, 0xba, 0xd8, 0x14, 0x4d, 0x37, 0x88, 0x5d, 0x20, 0x40, 0x90, 0x03, 0x25, 0x0d, 0x2d,
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    0xf7, 0xd6, 0x41, 0xfa, 0xcd, 0xbf, 0xf3, 0xb7, 0x4e, 0xac, 0x18, 0x07, 0x00, 0x00,
};
#endif
#if ESP32BASE_ENABLE_FS
// WebFsScript.js: 2046 B -> 839 B.
#define WEB_FS_SCRIPT_ASSET_VERSION "2701db50b362"
const uint8_t WEB_FS_SCRIPT_GZIP[] PROGMEM = {
    0x1f, 0x8b, 0x08, 0x00, 0x00, 0x00, 0x00, 0x00, 0x02, 0xff, 0xb5, 0x55, 0x4d, 0x6f, 0xdb, 0x38,
    0x10, 0xbd, 0xef, 0xaf, 0x50, 0x0e, 0x31, 0xc5, 0xb5, 0x41, 0x3b, 0xdd, 0x5b, 0x05, 0x22, 0xc0,
    0xa6, 0xc9, 0xb6, 0x8b, 0x4d, 0x53, 0x34, 0x09, 0x50, 0xa0, 0xe8, 0x81, 0x92, 0x46, 0xb6, 0x10,
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    0xbc, 0x5d, 0x8d, 0xfe, 0x07, 0x00, 0x00,
};
#endif
